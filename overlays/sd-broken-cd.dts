/dts-v1/;
/plugin/;

/*
 * Fly Lite 2.1: Orange Pi Lite DTB uses PF6 as SD card-detect.
 * Live U-Boot (Armbian 2026.07, model Xunlong Orange Pi Lite) reports
 * "MMC: no card present" after SPL already loaded U-Boot from that card.
 * Ignore CD so mmc0 always scans.
 *
 *   sudo armbian-add-overlay overlays/sd-broken-cd.dts
 *
 * U-Boot 2026.07 still honors cd-gpios after `mmc dev 0 0 1`.
 * At the prompt: `gpio clear PF6` then `mmc dev 0`, or
 * `fdt rm /soc/mmc@1c0f000 cd-gpios` then `mmc dev 0`.
 * Autoboot needs this change in the U-Boot DTB, not only Linux.
 */

/ {
	compatible = "allwinner,sun8i-h3";

	fragment@0 {
		target = <&mmc0>;
		__overlay__ {
			broken-cd;
			/delete-property/ cd-gpios;
		};
	};
};
